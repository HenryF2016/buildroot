## configs/zynq_microzed_x11_defconfig
```kconfig
BR2_arm=y
BR2_cortex_a9=y
BR2_ARM_ENABLE_NEON=y
BR2_ARM_ENABLE_VFP=y
BR2_PACKAGE_HOST_LINUX_HEADERS_CUSTOM_4_4=y
BR2_TARGET_GENERIC_GETTY_PORT="ttyPS0"
BR2_LINUX_KERNEL=y
BR2_LINUX_KERNEL_CUSTOM_GIT=y
BR2_LINUX_KERNEL_CUSTOM_REPO_URL="https://github.com/Xilinx/linux-xlnx.git"
BR2_LINUX_KERNEL_CUSTOM_REPO_VERSION="xilinx-v2016.2"
BR2_LINUX_KERNEL_DEFCONFIG="xilinx_zynq"
BR2_LINUX_KERNEL_UIMAGE=y
BR2_LINUX_KERNEL_UIMAGE_LOADADDR="0x8000"
BR2_LINUX_KERNEL_DTS_SUPPORT=y
BR2_LINUX_KERNEL_INTREE_DTS_NAME="zynq-zed"
BR2_TARGET_ROOTFS_CPIO=y
BR2_TARGET_ROOTFS_CPIO_GZIP=y
BR2_TARGET_ROOTFS_CPIO_UIMAGE=y
BR2_TARGET_UBOOT=y
BR2_TARGET_UBOOT_BUILD_SYSTEM_KCONFIG=y
BR2_TARGET_UBOOT_CUSTOM_GIT=y
BR2_TARGET_UBOOT_CUSTOM_REPO_URL="https://github.com/Xilinx/u-boot-xlnx.git"
BR2_TARGET_UBOOT_CUSTOM_REPO_VERSION="xilinx-v2016.2"
BR2_TARGET_UBOOT_BOARD_DEFCONFIG="zynq_microzed"
BR2_TARGET_UBOOT_NEEDS_DTC=y
BR2_TARGET_UBOOT_NEEDS_OPENSSL=y
BR2_TARGET_UBOOT_FORMAT_IMG=y
BR2_TARGET_UBOOT_SPL=y
BR2_TARGET_UBOOT_SPL_NAME="spl/boot.bin"
BR2_ROOTFS_SKELETON_DEFAULT=y
BR2_PACKAGE_SYSTEMD_NETWORKD=y
BR2_SYSTEM_DHCP="eth0"
BR2_PACKAGE_IFUPDOWN=y
BR2_TARGET_GENERIC_HOSTNAME="mz-x11"
BR2_TOOLCHAIN_BUILDROOT_WCHAR=y
BR2_TOOLCHAIN_BUILDROOT=y
BR2_TOOLCHAIN_BUILDROOT_UCLIBC=y
BR2_USE_WCHAR=y
BR2_TOOLCHAIN_BUILDROOT_CXX=y
BR2_INSTALL_LIBSTDCPP=y
BR2_PACKAGE_LUA=y
BR2_PACKAGE_NODEJS=y
BR2_TOOLCHAIN_HAS_THREADS=y
BR2_HOST_GCC_AT_LEAST_4_8=y
BR2_TOOLCHAIN_GCC_AT_LEAST_4_8=y
BR2_USE_MMU=y
BR2_PACKAGE_ZLIB=y
BR2_PACKAGE_NODEJS_NPM=y
BR2_PACKAGE_NODEJS_MODULES_EXPRESS=y
BR2_PACKAGE_PYTHON=y
BR2_PACKAGE_NODEJS_MODULES_ADDITIONAL="node-red"
BR2_PACKAGE_PYTHON_CHEETAH=y
BR2_PACKAGE_PYTHON_ZLIB=y
BR2_PACKAGE_PYTHON_CHERRYPY=y
BR2_PACKAGE_PYTHON_DJANGO=y
BR2_PACKAGE_PYTHON_UNICODEDATA=y
BR2_PACKAGE_PYTHON_JINJA2=y
BR2_PACKAGE_PYTHON_MARKUPSAFE=y
BR2_TOOLCHAIN_USES_MUSL=y
BR2_PACKAGE_PYTHON_MAKO=y
BR2_PACKAGE_PYTHON_NUMPY=y
BR2_PACKAGE_PYTHON_NUMPY_ARCH_SUPPORTS=y
BR2_PACKAGE_OPENCV3_LIB_PYTHON=y
BR2_PACKAGE_OPENCV3=y
BR2_PACKAGE_GNURADIO_PYTHON=y
BR2_PACKAGE_GNURADIO=y
BR2_PACKAGE_PYTHON_PILLOW=y
BR2_PACKAGE_PYTHON_PYPCAP=y
BR2_PACKAGE_LIBPCAP=y
BR2_PACKAGE_PYTHON_PYUSB=y
BR2_PACKAGE_LIBUSB=y
BR2_PACKAGE_LIBSYSFS=y
BR2_PACKAGE_OPENOCD_SYSFS=y
BR2_PACKAGE_OPENOCD=y
BR2_PACKAGE_LIBSSH=y
BR2_PACKAGE_OPENSSL=y
BR2_PACKAGE_LIBSSH2=y
BR2_PACKAGE_OPENSSH=y
BR2_PACKAGE_MTD_FLASHCP=y
BR2_PACKAGE_MTD=y
BR2_TARGET_ENABLE_ROOT_LOGIN=y
BR2_TARGET_GENERIC_ROOT_PASSWD='root'
BR2_PACKAGE_DROPBEAR=y
BR2_ROOTFS_POST_IMAGE_SCRIPT="board/zynq/microzed/post-image.sh"
BR2_PACKAGE_HOST_DOSFSTOOLS=y
BR2_PACKAGE_HOST_GENIMAGE=y
BR2_PACKAGE_HOST_MTOOLS=y
BR2_TARGET_ROOTFS_EXT2=y
BR2_TARGET_ROOTFS_EXT2_4=y
BR2_PACKAGE_JPEG=y
BR2_PACKAGE_XLIB_LIBXINERAMA=y
BR2_PACKAGE_XLIB_LIBXRANDR=y
BR2_PACKAGE_XLIB_LIBXDAMAGE=y
BR2_PACKAGE_X11VNC=y
BR2_PACKAGE_XORG7=y
BR2_PACKAGE_XLIB_LIBXT=y
BR2_PACKAGE_XLIB_LIBXEXT=y
BR2_PACKAGE_XLIB_LIBXTST=y
BR2_PACKAGE_XSERVER_XORG_SERVER=y
BR2_PACKAGE_XSERVER_XORG_SERVER_XVFB=y
BR2_PACKAGE_XTERM=y
BR2_PACKAGE_NCURSES=y
BR2_PACKAGE_XLIB_LIBXAW=y
BR2_PACKAGE_XAPP_TWM=y
BR2_PACKAGE_XAPP_XCLOCK=y
BR2_PACKAGE_XAPP_SETXKBMAP=y
BR2_PACKAGE_XAPP_XINIT=y
BR2_PACKAGE_XAPP_XINPUT=y
BR2_PACKAGE_XDRIVER_XF86_INPUT_KEYBOARD=y
BR2_PACKAGE_XDRIVER_XF86_INPUT_MOUSE=y
BR2_ENABLE_LOCALE=y
BR2_PACKAGE_EUDEV=y
BR2_PACKAGE_LINUX_TOOLS=y
BR2_PACKAGE_LINUX_TOOLS_PERF=y
BR2_PACKAGE_E2FSPROGS_DEBUGFS=y
BR2_PACKAGE_E2FSPROGS=y
BR2_TOOLCHAIN_HAS_THREADS_DEBUG=y
BR2_PACKAGE_GDB=y
BR2_PACKAGE_GDB_SERVER=y
BR2_PTHREAD_DEBUG=y
BR2_PACKAGE_GDB_PYTHON=y
BR2_PACKAGE_TREE=y
BR2_PACKAGE_PYTHON_SETUPTOOLS=y
BR2_PACKAGE_OPENSSL_BIN=y
BR2_PACKAGE_OPENSSL_ENGINES=y
BR2_PACKAGE_PYTHON_PYOPENSSL=y
BR2_TARGET_UBOOT_FORMAT_DTB_IMG=y
BR2_TARGET_UBOOT_ZYNQ_IMAGE=y
BR2_PACKAGE_NSS_MDNS=y
BR2_TOOLCHAIN_USES_GLIBC=y
BR2_PACKAGE_AVAHI_DAEMON=y
BR2_PACKAGE_AVAHI=y
BR2_PACKAGE_AVAHI_AUTOIPD=y
BR2_PACKAGE_AVAHI_DAEMON=y
BR2_PACKAGE_AVAHI_LIBDNSSD_COMPATIBILITY=y
BR2_PACKAGE_SAMBA4=y
```

## package/python-ivi/Config.in
```kconfig
config BR2_PACKAGE_PYTHON_IVI
  bool "python-ivi"
  help
    The IVI module provides access IVI instruments from Python. 
    
    https://github.com/python-ivi/python-ivi
```

## package/python-periphery/Config.in
```kconfig
config BR2_PACKAGE_PYTHON_PERIPHERY
  bool "python-periphery"
  help
    The PYTHON-PERIPHERY module provides sysfs IO access from Python. 
   
    https://github.com/vsergeev/python-periphery
```

## package/python-vxi11/Config.in
```kconfig
config BR2_PACKAGE_PYTHON_VXI11
  bool "python-vxi11"
  help
    The VXI11 module provides access VXI11 instruments from Python. 
    
    https://github.com/python-ivi/python-vxi11
```
